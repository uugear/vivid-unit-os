## uboot/configs/vivid_unit_defconfig
```kconfig
CONFIG_ARM=y
CONFIG_SKIP_LOWLEVEL_INIT=y
CONFIG_COUNTER_FREQUENCY=24000000
CONFIG_ARCH_ROCKCHIP=y
CONFIG_SPL_GPIO=y
CONFIG_NR_DRAM_BANKS=1
CONFIG_SF_DEFAULT_SPEED=30000000
CONFIG_ENV_SIZE=0x8000
CONFIG_ENV_OFFSET=0x3F8000
CONFIG_ENV_SECT_SIZE=0x1000
CONFIG_DEFAULT_DEVICE_TREE="rockchip/rk3399-vivid-unit"
CONFIG_DM_RESET=y
CONFIG_ROCKCHIP_RK3399=y
CONFIG_ROCKCHIP_EXTERNAL_TPL=y
CONFIG_ROCKCHIP_SPI_IMAGE=y
CONFIG_TARGET_ROC_PC_RK3399=y
CONFIG_SYS_LOAD_ADDR=0x800800
CONFIG_SF_DEFAULT_BUS=1
CONFIG_DEBUG_UART_BASE=0xFF1A0000
CONFIG_DEBUG_UART_CLOCK=24000000
CONFIG_SPL_SPI_FLASH_SUPPORT=y
CONFIG_SPL_SPI=y
CONFIG_DEBUG_UART=y
# CONFIG_ANDROID_BOOT_IMAGE is not set
CONFIG_BOOTCOMMAND="gpio set 32; if mmc dev 0; then setenv bootargs earlycon=uart8250,mmio32,0xff1a0000 console=tty1 console=ttyS2,115200n8 root=/dev/mmcblk0p3 rootwait rw rootfstype=ext4 loglevel=7 ignore_loglevel fbcon=nodefer logo.nologo; if ext4load mmc 0:2 ${kernel_addr_r} /Image; then if ext4load mmc 0:2 ${fdt_addr_r} /dtbs/rk3399-vivid-unit.dtb; then gpio clear 45; booti ${kernel_addr_r} - ${fdt_addr_r}; fi; fi; if ext4load mmc 0:3 ${kernel_addr_r} /boot/Image; then if ext4load mmc 0:3 ${fdt_addr_r} /boot/dtbs/rk3399-vivid-unit.dtb; then gpio clear 45; booti ${kernel_addr_r} - ${fdt_addr_r}; fi; fi; fi; bootflow scan -lb"
CONFIG_USE_PREBOOT=y
CONFIG_PREBOOT="setenv stdout serial,vidconsole; setenv stderr serial,vidconsole; gpio set 32"
CONFIG_DEFAULT_FDT_FILE="rockchip/rk3399-vivid-unit.dtb"
CONFIG_DISPLAY_BOARDINFO_LATE=y
# CONFIG_CYCLIC is not set
CONFIG_SPL_MAX_SIZE=0x40000
CONFIG_SPL_PAD_TO=0x7f8000
# CONFIG_SPL_RAW_IMAGE_SUPPORT is not set
CONFIG_SPL_ENV_SUPPORT=y
CONFIG_SPL_SPI_LOAD=y
CONFIG_SYS_SPI_U_BOOT_OFFS=0xE0000
CONFIG_SPL_ATF_NO_PLATFORM_PARAM=y
CONFIG_TPL=y
CONFIG_CMD_BOOTZ=y
CONFIG_CMD_GPT=y
CONFIG_CMD_MMC=y
CONFIG_CMD_GPIO=y
CONFIG_CMD_USB=y
# CONFIG_CMD_SETEXPR is not set
CONFIG_CMD_TIME=y
CONFIG_SPL_OF_CONTROL=y
CONFIG_OF_SPL_REMOVE_PROPS="clock-names interrupt-parent assigned-clocks assigned-clock-rates assigned-clock-parents"
CONFIG_OF_LIVE=y
CONFIG_OFNODE_MULTI_TREE=y
CONFIG_OFNODE_MULTI_TREE_MAX=4
CONFIG_ENV_IS_IN_SPI_FLASH=y
CONFIG_SYS_RELOC_GD_ENV_ADDR=y
CONFIG_ROCKCHIP_GPIO=y
CONFIG_SYS_I2C_ROCKCHIP=y
CONFIG_ROCKCHIP_IODOMAIN=y
CONFIG_MMC_DW=y
CONFIG_MMC_DW_ROCKCHIP=y
CONFIG_MMC_SDHCI=y
CONFIG_MMC_SDHCI_SDMA=y
CONFIG_MMC_SDHCI_ROCKCHIP=y
CONFIG_SPI_FLASH_SFDP_SUPPORT=y
CONFIG_SPI_FLASH_WINBOND=y
CONFIG_PHY_REALTEK=y
CONFIG_DM_ETH_PHY=y
CONFIG_ETH_DESIGNWARE=y
CONFIG_GMAC_ROCKCHIP=y
CONFIG_PHY_ROCKCHIP_INNO_DSIDPHY=y
CONFIG_PHY_ROCKCHIP_INNO_USB2=y
CONFIG_PHY_ROCKCHIP_TYPEC=y
CONFIG_PMIC_RK8XX=y
CONFIG_REGULATOR_PWM=y
CONFIG_DM_REGULATOR_COMMON=y
CONFIG_DM_REGULATOR_FIXED=y
CONFIG_SPL_DM_REGULATOR_FIXED=y
CONFIG_REGULATOR_RK8XX=y
CONFIG_PWM_ROCKCHIP=y
# CONFIG_RAM_ROCKCHIP_DEBUG is not set
CONFIG_RAM_ROCKCHIP_LPDDR4=y
CONFIG_SPECIFY_CONSOLE_INDEX=y
CONFIG_CONSOLE_MUX=y
CONFIG_SYS_CONSOLE_IS_IN_ENV=y
CONFIG_DEBUG_UART_SHIFT=2
CONFIG_SYS_NS16550_MEM32=y
CONFIG_ROCKCHIP_SERIAL=y
CONFIG_ROCKCHIP_SPI=y
CONFIG_SYSRESET=y
CONFIG_USB=y
CONFIG_USB_XHCI_HCD=y
CONFIG_USB_EHCI_HCD=y
CONFIG_USB_EHCI_GENERIC=y
CONFIG_USB_OHCI_HCD=y
CONFIG_USB_OHCI_GENERIC=y
CONFIG_USB_DWC3=y
CONFIG_USB_DWC3_GENERIC=y
CONFIG_USB_KEYBOARD=y
CONFIG_USB_HOST_ETHER=y
CONFIG_USB_ETHER_ASIX=y
CONFIG_USB_ETHER_ASIX88179=y
CONFIG_USB_ETHER_MCS7830=y
CONFIG_USB_ETHER_RTL8152=y
CONFIG_USB_ETHER_SMSC95XX=y
CONFIG_USB_GADGET=y
CONFIG_VIDEO=y
CONFIG_VIDEO_FONT_8X16=y
CONFIG_VIDEO_ANSI=y
CONFIG_SYS_WHITE_ON_BLACK=y
CONFIG_VIDEO_SYNC_MS=100
CONFIG_DISPLAY=y
CONFIG_BACKLIGHT=y
CONFIG_BACKLIGHT_PWM=y
CONFIG_MIPI_DPHY_HELPERS=y
CONFIG_VIDEO_BRIDGE=y
CONFIG_VIDEO_MIPI_DSI=y
CONFIG_VIDEO_DW_MIPI_DSI=y
CONFIG_VIDEO_ROCKCHIP=y
CONFIG_VIDEO_ROCKCHIP_MAX_XRES=1920
CONFIG_VIDEO_ROCKCHIP_MAX_YRES=1280
CONFIG_DISPLAY_ROCKCHIP_MIPI=y
CONFIG_DISPLAY_ROCKCHIP_DW_MIPI=y
CONFIG_PANEL=y
CONFIG_VIDEO_LCD_JH550172Q=y
CONFIG_CMD_BMP=y
CONFIG_BMP=y
CONFIG_VIDEO_LOGO=y
# CONFIG_SPLASH_SCREEN is not set
# CONFIG_SPLASH_SCREEN_ALIGN is not set
CONFIG_BMP_16BPP=y
CONFIG_BMP_24BPP=y
CONFIG_BMP_32BPP=y
CONFIG_VIDEO_BMP_GZIP=y
CONFIG_VIDEO_BMP_RLE8=y
# CONFIG_DISPLAY_ROCKCHIP_HDMI is not set
# CONFIG_SPL_CRC8 is not set
CONFIG_ERRNO_STR=y
# CONFIG_TOOLS_MKEFICAPSULE is not set
```
