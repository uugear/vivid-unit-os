// SPDX-License-Identifier: (GPL-2.0+ OR MIT)
/*
 * U-Boot device tree for Vivid Unit.
 */

/dts-v1/;
#include <dt-bindings/input/gpio-keys.h>
#include <dt-bindings/clock/rk3399-cru.h>
#include <dt-bindings/pwm/pwm.h>
#include <dt-bindings/input/input.h>
#include <dt-bindings/leds/common.h>
#include <dt-bindings/gpio/gpio.h>
#include <dt-bindings/pinctrl/rockchip.h>
#include "rk3399.dtsi"
#include "rk3399-vivid-unit-common.dtsi"
#include "rk3399-vivid-unit-u-boot.dtsi"
