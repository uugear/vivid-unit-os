/dts-v1/;
/plugin/;

/ {
	compatible = "rockchip,rk3399";
};

&hdmi {
	pinctrl-names = "default";
	pinctrl-0 = <&hdmi_i2c_xfer>, <&hdmi_cec>;
	#sound-dai-cells = <0>;
	status = "okay";
};

&display_subsystem {
	ports = <&vopl_out &vopb_out>;
	status = "okay";
};

&route_hdmi {
	status = "okay";
	connect = <&vopb_out_hdmi>;
};